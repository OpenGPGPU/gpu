/*
 * RISC-V SIMT GPU device-tree binding.
 *
 * The GPU is an accelerator on the SoC bus with a single AXI4 memory-mapped
 * control port (the ctrl resource) and a completion interrupt.  ALL buffers
 * (command buffer, kernarg, colour, depth) are software-allocated regions in
 * the host's physical memory; the driver programs their addresses through the
 * control registers.  This matches the integrated-SoC morphology: host RV64
 * and GPU share one coherent DRAM through the shared L2.
 */
/ {
    opengpu: gpu@b000000 {
        compatible = "riscv-simt,opengpu";
        reg = <0x0b000000 0x1000>;
        reg-names = "ctrl";
        interrupts = <180>;                 /* completion (wired by ARTI) */
        interrupt-parent = <&intc>;
        /* Optional boot-time mode. It must match the elaborated RTL
         * resolution (EmitGpuHostSystemAxi --width/--height) and the
         * integration profile's display block, which is the single source of
         * the resolution; scripts/gpu_display_config.py reads it and
         * scripts/test_driver.py checks the values below still agree.
         * The ARTI-generated node omits these properties, so today the driver
         * falls back to its OPENGPU_DEFAULT_WIDTH/HEIGHT compile-time
         * defaults, which the build derives from the same profile. */
        opengpu,width = <64>;
        opengpu,height = <64>;
        opengpu,stride = <0x100>;               /* width * 4 */
        #address-cells = <1>;
        #size-cells = <1>;
    };
};
